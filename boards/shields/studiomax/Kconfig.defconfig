## boards/shields/studiomax/Kconfig.shield
```kconfig
config SHIELD_STUDIOMAX_LEFT
    def_bool $(shields_list_contains,studiomax_left)

config SHIELD_STUDIOMAX_RIGHT
    def_bool $(shields_list_contains,studiomax_right)
```
